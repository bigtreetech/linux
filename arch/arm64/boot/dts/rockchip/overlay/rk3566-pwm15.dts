/dts-v1/;
/plugin/;

#include <dt-bindings/gpio/gpio.h>
#include <dt-bindings/pinctrl/rockchip.h>
#include <dt-bindings/power/rk3568-power.h>
#include <dt-bindings/interrupt-controller/irq.h>

/ {		
	fragment@0 {
		target = <&pwm15>;

		__overlay__ {
			status = "okay";
		
		};
	};
	
};	
