/dts-v1/;
/plugin/;

#include <dt-bindings/gpio/gpio.h>
#include <dt-bindings/pinctrl/rockchip.h>
#include <dt-bindings/power/rk3568-power.h>
#include <dt-bindings/interrupt-controller/irq.h>

/ {
		
	fragment@0 {
		target = <&spi1>;

		__overlay__ {
			status = "okay";
			//pinctrl-0=<&spi1m1_pins>;
		};
	};

	fragment@1 {
		target = <&can_mcp2515>;

		__overlay__ {
			 status = "okay";
		};
	};
		
};