/dts-v1/;
/plugin/;

/ {
	compatible = "rockchip,rk3566";

	fragment@0 {
		target = <&spi1>;
		 __overlay__ {
			status = "okay";
		};
	};

	fragment@1 {
		target = <&tft_35>;
		__overlay__ {
			status = "okay";
			spi-max-frequency = <10000000>;
		};
	};

	fragment@2 {
		target = <&tp_ns2009>;
		__overlay__ {
			status = "okay";
		};
	};
};
