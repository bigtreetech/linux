/dts-v1/;
/plugin/;

/ {
	fragment@0 {
		target = <&i2c_gpio>;
			__overlay__ {
			status = "okay";
		};
	};

	fragment@1 {
		target = <&spi1>;
			__overlay__ {
			status = "okay";
		};
	};

	fragment@2 {
		target = <&tft43>;
		__overlay__ {
			status = "okay";
		};
	};

	fragment@3 {
		target = <&tp_tft43>;
		__overlay__ {
			status = "okay";
		};
	};
};
