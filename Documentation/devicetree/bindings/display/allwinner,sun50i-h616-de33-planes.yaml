## Documentation/devicetree/bindings/display/allwinner,sun50i-h616-de33-planes.yaml
```yaml
# SPDX-License-Identifier: GPL-2.0-only OR BSD-2-Clause
%YAML 1.2
---
$id: http://devicetree.org/schemas/display/allwinner,sun50i-h616-de33-planes.yaml#
$schema: http://devicetree.org/meta-schemas/core.yaml#

title: Allwinner H616 Display Engine 3.3 planes

maintainers:
  - Jernej Skrabec <jernej.skrabec@gmail.com>

description: |
  Display Engine 3.3 planes are independent of mixers, contrary to
  previous generations of Display Engine. Planes can be assigned to
  mixers independently and even dynamically during runtime.

properties:
  compatible:
    enum:
      - allwinner,sun50i-h616-de33-planes

  reg:
    maxItems: 1

  allwinner,plane-mapping:
    $ref: /schemas/types.yaml#/definitions/phandle
    description: Phandle of Display Engine clock node

required:
  - compatible
  - reg
  - allwinner,plane-mapping

additionalProperties: false

examples:
  - |
    planes: planes@100000 {
        compatible = "allwinner,sun50i-h616-de33-planes";
        reg = <0x100000 0x180000>;
        allwinner,plane-mapping = <&display_clocks>;
    };

...
```

## Documentation/devicetree/bindings/display/allwinner,sun8i-a83t-de2-mixer.yaml
```yaml
# SPDX-License-Identifier: GPL-2.0
%YAML 1.2
---
$id: http://devicetree.org/schemas/display/allwinner,sun8i-a83t-de2-mixer.yaml#
$schema: http://devicetree.org/meta-schemas/core.yaml#

title: Allwinner Display Engine 2.0 Mixer

maintainers:
  - Chen-Yu Tsai <wens@csie.org>
  - Maxime Ripard <mripard@kernel.org>

properties:
  compatible:
    enum:
      - allwinner,sun8i-a83t-de2-mixer-0
      - allwinner,sun8i-a83t-de2-mixer-1
      - allwinner,sun8i-h3-de2-mixer-0
      - allwinner,sun8i-r40-de2-mixer-0
      - allwinner,sun8i-r40-de2-mixer-1
      - allwinner,sun8i-v3s-de2-mixer
      - allwinner,sun20i-d1-de2-mixer-0
      - allwinner,sun20i-d1-de2-mixer-1
      - allwinner,sun50i-a64-de2-mixer-0
      - allwinner,sun50i-a64-de2-mixer-1
      - allwinner,sun50i-h6-de3-mixer-0
      - allwinner,sun50i-h616-de33-mixer-0

  reg: true

  reg-names: true

  clocks:
    items:
      - description: The mixer interface clock
      - description: The mixer module clock

  clock-names:
    items:
      - const: bus
      - const: mod

  iommus:
    maxItems: 1

  resets:
    maxItems: 1

  allwinner,planes:
    $ref: /schemas/types.yaml#/definitions/phandle
    description: Phandle of Display Engine 3.3 planes node

  ports:
    $ref: /schemas/graph.yaml#/properties/ports

    properties:
      port@0:
        $ref: /schemas/graph.yaml#/properties/port
        description: |
          Input endpoints of the controller.

      port@1:
        $ref: /schemas/graph.yaml#/properties/port
        description: |
          Output endpoints of the controller.

    required:
      - port@1

allOf:
  - if:
      properties:
        compatible:
          contains:
            enum:
              - allwinner,sun50i-h616-de33-mixer-0
    then:
      properties:
        reg:
          description: |
            Registers for display blending control (display) and global
            control (top). Names are from Allwinner BSP kernel.
          maxItems: 2
        reg-names:
          items:
            - const: display
            - const: top
      required:
        - reg-names
        - allwinner,planes

    else:
      properties:
        reg:
          maxItems: 1
        allwinner,planes: false

required:
  - compatible
  - reg
  - clocks
  - clock-names
  - resets
  - ports

additionalProperties: false

examples:
  - |
    #include <dt-bindings/clock/sun8i-de2.h>
    #include <dt-bindings/reset/sun8i-de2.h>

    mixer0: mixer@1100000 {
        compatible = "allwinner,sun8i-a83t-de2-mixer-0";
        reg = <0x01100000 0x100000>;
        clocks = <&display_clocks CLK_BUS_MIXER0>,
                 <&display_clocks CLK_MIXER0>;
        clock-names = "bus",
                      "mod";
        resets = <&display_clocks RST_MIXER0>;

        ports {
            #address-cells = <1>;
            #size-cells = <0>;

            mixer0_out: port@1 {
                #address-cells = <1>;
                #size-cells = <0>;
                reg = <1>;

                mixer0_out_tcon0: endpoint@0 {
                    reg = <0>;
                    remote-endpoint = <&tcon0_in_mixer0>;
                };

                mixer0_out_tcon1: endpoint@1 {
                    reg = <1>;
                    remote-endpoint = <&tcon1_in_mixer0>;
                };
            };
        };
    };

...
```

## Documentation/devicetree/bindings/media/rockchip,px30-vip.yaml
```yaml
# SPDX-License-Identifier: (GPL-2.0 OR BSD-2-Clause)
%YAML 1.2
---
$id: http://devicetree.org/schemas/media/rockchip,px30-vip.yaml#
$schema: http://devicetree.org/meta-schemas/core.yaml#

title: Rockchip Camera Interface (CIF)

maintainers:
  - Mehdi Djait <mehdi.djait@bootlin.com>

description:
  CIF is a camera interface present on some Rockchip SoCs. It receives the data
  from Camera sensor or CCIR656 encoder and transfers it into system main memory
  by AXI bus.

properties:
  compatible:
    enum:
      - rockchip,px30-vip
      - rockchip,rk3568-vicap

  reg:
    maxItems: 1

  interrupts:
    maxItems: 1

  clocks: true

  clock-names: true

  iommus:
    maxItems: 1

  resets: true

  reset-names: true

  rockchip,grf:
    $ref: /schemas/types.yaml#/definitions/phandle
    description:
      Phandle to general register file used for video input block control.

  power-domains:
    maxItems: 1

  ports:
    $ref: /schemas/graph.yaml#/properties/ports

    properties:
      port@0:
        $ref: /schemas/graph.yaml#/$defs/port-base
        unevaluatedProperties: false
        description: input port on the parallel interface

        properties:
          endpoint:
            $ref: video-interfaces.yaml#
            unevaluatedProperties: false

            properties:
              bus-type:
                enum: [5, 6]

            required:
              - bus-type

    required:
      - port@0

required:
  - compatible
  - reg
  - interrupts
  - clocks
  - ports

allOf:
  - if:
      properties:
        compatible:
          contains:
            const: rockchip,px30-vip
    then:
      properties:
        clocks:
          items:
            - description: ACLK
            - description: HCLK
            - description: PCLK

        clock-names:
          items:
            - const: aclk
            - const: hclk
            - const: pclk

        resets:
          items:
            - description: AXI
            - description: AHB
            - description: PCLK IN

        reset-names:
          items:
            - const: axi
            - const: ahb
            - const: pclkin
 - if:
      properties:
        compatible:
          contains:
            const: rockchip,rk3568-vicap
    then:
      properties:
        clocks:
          items:
            - description: ACLK
            - description: HCLK
            - description: DCLK
            - description: ICLK

        clock-names:
          items:
            - const: aclk
            - const: hclk
            - const: dclk
            - const: iclk

        resets:
          items:
            - description: ARST
            - description: HRST
            - description: DRST
            - description: PRST
            - description: IRST

        reset-names:
          items:
            - const: arst
            - const: hrst
            - const: drst
            - const: prst
            - const: irst

additionalProperties: false

examples:
  - |
    #include <dt-bindings/clock/px30-cru.h>
    #include <dt-bindings/interrupt-controller/arm-gic.h>
    #include <dt-bindings/media/video-interfaces.h>
    #include <dt-bindings/power/px30-power.h>

    parent {
        #address-cells = <2>;
        #size-cells = <2>;

        video-capture@ff490000 {
            compatible = "rockchip,px30-vip";
            reg = <0x0 0xff490000 0x0 0x200>;
            interrupts = <GIC_SPI 69 IRQ_TYPE_LEVEL_HIGH>;
            clocks = <&cru ACLK_CIF>, <&cru HCLK_CIF>, <&cru PCLK_CIF>;
            clock-names = "aclk", "hclk", "pclk";
            power-domains = <&power PX30_PD_VI>;
            resets = <&cru SRST_CIF_A>, <&cru SRST_CIF_H>, <&cru SRST_CIF_PCLKIN>;
            reset-names = "axi", "ahb", "pclkin";

            ports {
                #address-cells = <1>;
                #size-cells = <0>;

                port@0 {
                    reg = <0>;

                    cif_in: endpoint {
                        remote-endpoint = <&tw9900_out>;
                        bus-type = <MEDIA_BUS_TYPE_BT656>;
                    };
                };
            };
        };
    };
...
```

## drivers/leds/rgb/Kconfig
```kconfig
# SPDX-License-Identifier: GPL-2.0

if LEDS_CLASS_MULTICOLOR

config LEDS_PWM_MULTICOLOR
	tristate "PWM driven multi-color LED Support"
	depends on PWM
	help
	  This option enables support for PWM driven monochrome LEDs that are
	  grouped into multicolor LEDs.

	  To compile this driver as a module, choose M here: the module
	  will be called leds-pwm-multicolor.

config LEDS_QCOM_LPG
	tristate "LED support for Qualcomm LPG"
	depends on OF
	depends on PWM
	depends on SPMI
	help
	  This option enables support for the Light Pulse Generator found in a
	  wide variety of Qualcomm PMICs. The LPG consists of a number of PWM
	  channels and typically a shared pattern lookup table and a current
	  sink, intended to drive RGB LEDs. Each channel can either be used as
	  a LED, grouped to represent a RGB LED or exposed as PWM channels.

	  If compiled as a module, the module will be named leds-qcom-lpg.

endif # LEDS_CLASS_MULTICOLOR

config LEDS_WS2812
	tristate "WS2812 RGB support for allwinner H616"
	depends on PINCTRL_SUN50I_H616

	help
	  Say Y here if you want to use the WS2812.
```

## drivers/media/platform/rockchip/cif/Kconfig
```kconfig
config VIDEO_ROCKCHIP_CIF
	tristate "Rockchip CIF Video Camera Interface"
	depends on VIDEO_DEV
	depends on ARCH_ROCKCHIP || COMPILE_TEST
	depends on V4L_PLATFORM_DRIVERS
	depends on PM && COMMON_CLK
	select MEDIA_CONTROLLER
	select VIDEOBUF2_DMA_CONTIG
	select V4L2_FWNODE
	select VIDEO_V4L2_SUBDEV_API
	help
	  This is a driver for Rockchip SoC Camera interface. It supports
	  parallel interfaces such as BT.656. This camera interface is both
	  called VIP and CIF.
```
